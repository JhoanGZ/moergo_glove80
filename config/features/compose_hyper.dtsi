/*
 * Accent layers + Hyper key (modular)
 *
 * Includes:
 * - Spanish accents (áéíóú ñ ß)
 * - German umlauts (äöü ß)
 * - Hyper macro (Ctrl+Alt+Shift+GUI) — available as &hyper_macro
 *
 * Usage in keymap:
 *   Accent key:  &sl LAYER_Accent
 *   Hyper key:   &hyper_macro  (assign to any key when needed)
 */

#define LAYER_Accent 4
#define LAYER_Umlaut 5

#include "spanish.dtsi"
#include "german.dtsi"

/ {
    macros {
        hyper_macro: hyper_macro {
            compatible = "zmk,behavior-macro";
            #binding-cells = <0>;
            wait-ms = <0>;
            bindings
                = <&macro_press &kp LCTRL &kp LALT &kp LSHFT &kp LGUI>
                , <&macro_pause_for_release>
                , <&macro_release &kp LCTRL &kp LALT &kp LSHFT &kp LGUI>;
        };
    };
};
